## meta-uptane-ota/conf/machine/qemuarm64-ota.conf
```bitbake
require conf/machine/qemuarm64.conf

WKS_FILE      = "ab-image-arm64.wks"
IMAGE_FSTYPES = "wic wic.gz ext4"

QB_SYSTEM_NAME    = "qemu-system-aarch64"
QB_MEM            = "-m 1024"
QB_MACHINE        = "-machine virt -cpu cortex-a57"
QB_NETWORK_DEVICE = "virtio-net-device"
QB_DEFAULT_FSTYPE = "wic"
QB_SERIAL_OPT     = "-nographic"

QB_OPT_APPEND:append = " \
    -object can-bus,id=canbus0 \
    -device kvaser_pci,canbus=canbus0 \
"

KERNEL_IMAGETYPE = "Image"
SERIAL_CONSOLES  = "115200;ttyAMA0"
```

## meta-uptane-ota/wic/ab-image-arm64.wks
```
part /boot --source bootimg-partition \
     --ondisk vda --fstype=vfat \
     --label boot --active --align 1024 --fixed-size 100M

part / --source rootfs \
     --ondisk vda --fstype=ext4 \
     --label rootfs-a --align 1024 --fixed-size 512M

part / --source empty \
     --ondisk vda --fstype=ext4 \
     --label rootfs-b --align 1024 --fixed-size 512M

part /data --source empty \
     --ondisk vda --fstype=ext4 \
     --label data --align 1024 --fixed-size 2048M

bootloader --ptable gpt --timeout=3 \
    --append="root=/dev/vda2 rw console=ttyAMA0,115200 rootwait"
```
